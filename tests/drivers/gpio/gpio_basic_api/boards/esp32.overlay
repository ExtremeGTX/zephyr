/*
 * Copyright (c) 2019 Mohamed ElShahawi
 *
 * SPDX-License-Identifier: Apache-2.0
 */

/ {
	resources {
		compatible = "test,gpio_basic_api";
		out-gpios = <&gpio1 0 0>;
		in-gpios = <&gpio1 2 0>;
	};
};
