## prj.conf
```kconfig
# nothing here
CONFIG_STDOUT_CONSOLE=y

#USB related configs
CONFIG_USB_DEVICE_STACK=y
CONFIG_USB_DEVICE_PRODUCT="SAMSUNG_Android"
CONFIG_USB_DEVICE_MANUFACTURER="SAMSUNG"
#CONFIG_USB_DEVICE_SN="R3AA111AABB"

CONFIG_LOG=y
CONFIG_USB_DRIVER_LOG_LEVEL_INF=y
CONFIG_USB_DEVICE_INITIALIZE_AT_BOOT=n

CONFIG_MAIN_STACK_SIZE=2048
CONFIG_FILE_SYSTEM=y
CONFIG_FILE_SYSTEM_MKFS=y
CONFIG_FILE_SYSTEM_LITTLEFS=y
CONFIG_FS_LITTLEFS_FMP_DEV=y

CONFIG_SHELL=y
CONFIG_FILE_SYSTEM_SHELL=y
CONFIG_HEAP_MEM_POOL_SIZE=16384

CONFIG_DISK_DRIVERS=y
CONFIG_DISK_ACCESS=y
CONFIG_DISK_DRIVER_FLASH=y


CONFIG_USB_MTP=y
#CONFIG_USB_DEVICE_LOG_LEVEL_DBG=y
CONFIG_LOG_PROCESS_TRIGGER_THRESHOLD=5
CONFIG_LOG_BUFFER_SIZE=65536

CONFIG_USB_DEVICE_VID=0x04E8
CONFIG_USB_DEVICE_PID=0x6860


# How to make this works with the default value ? why 3 retrials are not enough ?
CONFIG_USB_NUMOF_EP_WRITE_RETRIES=5
```

## src/main.c
```c
/*
 * Copyright (c) 2012-2014 Wind River Systems, Inc.
 *
 * SPDX-License-Identifier: Apache-2.0
 */

#include <stdio.h>
#include <zephyr/shell/shell.h>
#include <zephyr/usb/usb_device.h>
#include <zephyr/usb/usbd.h>

static int cmd_enable_usb(const struct shell *sh, size_t argc, char **argv)
{
	ARG_UNUSED(argc);
	ARG_UNUSED(argv);

	shell_print(sh, "Enabling USB");

	int ret = usb_enable(NULL);
	if (ret != 0) {
		shell_error(sh, "Failed to enable USB %d", ret);
		return 0;
	}


	return 0;
}


int main(void)
{
	printf("Hello World! %s\n", CONFIG_BOARD_TARGET);
	return 0;
}

SHELL_CMD_ARG_REGISTER(enable_usb, NULL, "Enable USB Subsys", cmd_enable_usb, 1, 0);
```
